## drivers/power/Kconfig
```kconfig
menuconfig POWER_SUPPLY
	bool "Power supply class support"
	help
	  Say Y here to enable power supply class support. This allows
	  power supply (batteries, AC, USB) monitoring by userspace
	  via sysfs and uevent (if available) and/or APM kernel interface
	  (if selected below).

if POWER_SUPPLY

config POWER_SUPPLY_DEBUG
	bool "Power supply debug"
	help
	  Say Y here to enable debugging messages for power supply class
	  and drivers.

config PDA_POWER
	tristate "Generic PDA/phone power driver"
	depends on !S390
	help
	  Say Y here to enable generic power driver for PDAs and phones with
	  one or two external power supplies (AC/USB) connected to main and
	  backup batteries, and optional builtin charger.

config APM_POWER
	tristate "APM emulation for class batteries"
	depends on APM_EMULATION
	help
	  Say Y here to enable support APM status emulation using
	  battery class devices.

config GENERIC_ADC_BATTERY
	tristate "Generic battery support using IIO"
	depends on IIO
	help
	  Say Y here to enable support for the generic battery driver
	  which uses IIO framework to read adc.

config TEST_POWER
	tristate "Test power driver"
	help
	  This driver is used for testing. It's safe to say M here.

config BATTERY_PMU
	tristate "Apple PMU battery"
	depends on PPC32 && ADB_PMU
	help
	  Say Y here to expose battery information on Apple machines
	  through the generic battery class.

config BATTERY_OLPC
	tristate "One Laptop Per Child battery"
	depends on X86_32 && OLPC
	help
	  Say Y to enable support for the battery on the OLPC laptop.

config BATTERY_TOSA
	tristate "Sharp SL-6000 (tosa) battery"
	depends on MACH_TOSA && MFD_TC6393XB && TOUCHSCREEN_WM97XX
	help
	  Say Y to enable support for the battery on the Sharp Zaurus
	  SL-6000 (tosa) models.

config BATTERY_COLLIE
	tristate "Sharp SL-5500 (collie) battery"
	depends on SA1100_COLLIE && MCP_UCB1200
	help
	  Say Y to enable support for the battery on the Sharp Zaurus
	  SL-5500 (collie) models.

config BATTERY_IPAQ_MICRO
	tristate "iPAQ Atmel Micro ASIC battery driver"
	depends on MFD_IPAQ_MICRO
	help
	  Choose this option if you want to monitor battery status on
	  Compaq/HP iPAQ h3100 and h3600.

config BATTERY_SBS
        tristate "SBS Compliant gas gauge"
        depends on I2C
        help
	  Say Y to include support for SBS battery driver for SBS-compliant
	  gas gauges.

config BATTERY_Z2
	tristate "Z2 battery driver"
	depends on I2C && MACH_ZIPIT2
	help
	  Say Y to include support for the battery on the Zipit Z2.

config BATTERY_S3C_ADC
	tristate "Battery driver for Samsung ADC based monitoring"
	depends on S3C_ADC
	help
	  Say Y here to enable support for iPAQ h1930/h1940/rx1950 battery

config BATTERY_TWL4030_MADC
	tristate "TWL4030 MADC battery driver"
	depends on TWL4030_MADC
	help
	  Say Y here to enable this dumb driver for batteries managed
	  through the TWL4030 MADC.

config CHARGER_PCF50633
	tristate "NXP PCF50633 MBC"
	depends on MFD_PCF50633
	help
	 Say Y to include support for NXP PCF50633 Main Battery Charger.

config BATTERY_JZ4740
	tristate "Ingenic JZ4740 battery"
	depends on MACH_JZ4740
	depends on MFD_JZ4740_ADC
	help
	  Say Y to enable support for the battery on Ingenic JZ4740 based
	  boards.

	  This driver can be build as a module. If so, the module will be
	  called jz4740-battery.

config BATTERY_INTEL_MID
	tristate "Battery driver for Intel MID platforms"
	depends on INTEL_SCU_IPC && SPI
	help
	  Say Y here to enable the battery driver on Intel MID
	  platforms.

config BATTERY_RX51
	tristate "Nokia RX-51 (N900) battery driver"
	depends on TWL4030_MADC
	help
	  Say Y here to enable support for battery information on Nokia
	  RX-51, also known as N900 tablet.

config CHARGER_ISP1704
	tristate "ISP1704 USB Charger Detection"
	depends on USB_PHY
	help
	  Say Y to enable support for USB Charger Detection with
	  ISP1707/ISP1704 USB transceivers.

config CHARGER_TWL4030
	tristate "OMAP TWL4030 BCI charger driver"
	depends on TWL4030_CORE
	help
	  Say Y here to enable support for TWL4030 Battery Charge Interface.

config CHARGER_LP8727
	tristate "TI/National Semiconductor LP8727 charger driver"
	depends on I2C
	help
	  Say Y here to enable support for LP8727 Charger Driver.

config CHARGER_LP8788
	tristate "TI LP8788 charger driver"
	depends on MFD_LP8788
	depends on LP8788_ADC
	depends on IIO
	help
	  Say Y to enable support for the LP8788 linear charger.

config CHARGER_GPIO
	tristate "GPIO charger"
	depends on GPIOLIB
	help
	  Say Y to include support for chargers which report their online status
	  through a GPIO pin.

	  This driver can be build as a module. If so, the module will be
	  called gpio-charger.

config CHARGER_MANAGER
	bool "Battery charger manager for multiple chargers"
	depends on REGULATOR && RTC_CLASS
	select EXTCON
	help
          Say Y to enable charger-manager support, which allows multiple
          chargers attached to a battery and multiple batteries attached to a
          system. The charger-manager also can monitor charging status in
          runtime and in suspend-to-RAM by waking up the system periodically
          with help of suspend_again support.

config QPNP_CHARGER
	tristate "QPNP Charger driver"
	depends on SPMI || MSM_SPMI
 	depends on OF_SPMI
	depends on THERMAL_QPNP_ADC_TM
	help
	  Say Y here to enable the switch mode battery charger
	  and boost device which supports USB detection and charging. The driver
	  also offers relevant information to userspace via the power supply
	  framework.

config FUELGAUGE_STC3117
	tristate "STC3117 fuel gauge driver"
	default n
	depends on I2C
	help
	  Say Y to include support
	  for STC3117 fuel gauge driver for batteries.
	  This driver source code implemented
	  all functions for STC3117 fuel gauge.

config QPNP_FG
	tristate "QPNP fuel gauge driver"
	depends on SPMI || MSM_SPMI
	depends on OF_SPMI
	help
	  Say Y here to enable the Fuel Gauge driver. This adds support for
	  battery fuel gauging and state of charge of battery connected to the
	  fuel gauge. The state of charge is reported through a BMS power
	  supply property and also sends uevents when the capacity is updated.

config QPNP_FG_GEN3
	tristate "QPNP GEN3 fuel gauge driver"
	depends on SPMI || MSM_SPMI
	depends on OF_SPMI
	help
	  Say Y here to enable the GEN3 Fuel Gauge driver. This adds support
	  for battery fuel gauging and state of charge of battery connected to
	  the fuel gauge. The state of charge is reported through a BMS power
	  supply property and also sends uevents when the capacity is updated.

config BATTERY_BCL
	tristate "Battery Current Limit driver"
	depends on THERMAL_MONITOR
	help
	  Say Y here to enable support for battery current limit
	  device. The BCL driver will poll BMS if
	  thermal daemon enables BCL.
	  It will notify thermal daemon if IBat crosses Imax threshold.

config CHARGER_TPS65090
	tristate "TPS65090 battery charger driver"
	depends on MFD_TPS65090
	help
	 Say Y here to enable support for battery charging with TPS65090
	 PMIC chips.

config AB8500_BM
	bool "AB8500 Battery Management Driver"
	depends on AB8500_CORE && AB8500_GPADC
	help
	  Say Y to include support for AB8500 battery management.

config BATTERY_GOLDFISH
	tristate "Goldfish battery driver"
	depends on GOLDFISH || COMPILE_TEST
	depends on HAS_IOMEM
	help
	  Say Y to enable support for the battery and AC power in the
	  Goldfish emulator.

config QPNP_VM_BMS
	tristate "QPNP Voltage-Mode Battery Monitoring System driver"
	depends on SPMI || MSM_SPMI
	depends on MSM_QPNP_INT
	help
	  Say Y here to enable support for QPNP chip vm-bms device.
	  The voltage-mode (vm) BMS driver uses periodic VBATT
	  readings from the battery to calculate the State of
	  Charge.

config QPNP_BMS
	tristate "QPNP Battery Monitoring System driver"
	depends on SPMI || MSM_SPMI
	depends on MSM_QPNP_INT
	help
	  Say Y here to enable support for QPNP chip bms device.
	  It registers a fuelgauge bms power supply to report
	  State of Charge.

config QPNP_LINEAR_CHARGER
	tristate "QPNP Linear Charger driver"
	depends on SPMI || MSM_SPMI
	depends on OF_SPMI
	depends on MSM_QPNP_INT
	depends on THERMAL_QPNP_ADC_TM
	help
	  Say Y here to enable the Linear battery charger which supports USB
	  detection and charging. The driver also offers relevant information
	  to userspace via the power supply framework.

config QPNP_TYPEC
	tristate "QPNP Type-C driver"
	depends on SPMI || MSM_SPMI
	depends on OF_SPMI
	depends on MSM_QPNP_INT
	help
	  Say Y here to enable QPNP Type-C driver.
	  The QPNP Type-C module supports the USB type-C protocol. It supports type-C
	  cable detection and other type-C parameters such as current-capability and
	  CC-orientation. The module does not support USB power-delivery. The driver
	  adds support to report these type-C parameters via the power-supply
	  framework.

config MSM_BCL_CTL
	bool "BCL Framework driver"
	help
	  Say Y here to enable this BCL Framework driver. This driver provides
	  interface, which can be used by the BCL h/w drivers to implement the
	  basic functionalities. This framework abstracts the underlying
	  hardware for the top level modules.

config MSM_BCL_PERIPHERAL_CTL
	bool "BCL driver to control the PMIC BCL peripheral"
	depends on SPMI || MSM_SPMI
	depends on MSM_BCL_CTL
	help
	  Say Y here to enable this BCL PMIC peripheral driver. This driver
	  provides routines to configure and monitor the BCL
	  PMIC peripheral.

config C3B_BQ2560X
	bool "to seperate different projects"
	default n
	help
	  Say Y here to enable a function which disabled TEMP protect...
	  WARNNING:Only SCM could open it.

config GAUGE_BQ27426
	tristate "BQ27426 Battery Fg"
	depends on I2C
	help
	  Say Y to include support for BQ27426 Battery Charger.
	  BQ27426 is a single path switching mode charger capable of charging
	  the battery with 2Amps of current.
	  The driver supports charger enable/disable.
	  The driver reports the charger status via the power supply framework.
	  A charger status change triggers an IRQ via the device STAT pin.

config CHARGER_BQ2560
	tristate "BQ2560X Battery Charger"
	depends on I2C
	help
	  Say Y to include support for BQ2560X Battery Charger.
	  BQ2560X is a single path switching mode charger capable of charging
	  the battery with 2Amps of current.
	  The driver supports charger enable/disable.
	  The driver reports the charger status via the power supply framework.
	  A charger status change triggers an IRQ via the device STAT pin.

config DISABLE_TEMP_PROTECT
	bool "control of TEMP protect"
	default n
	help
	  Say Y here to enable a function which disabled TEMP protect...
	  WARNNING:Only SCM could open it.

config QNS_SYSTEM
	bool "Qnovo QNS wrapper implementation"
	default n
	help
	  Say Y here to enable support for QNS system.
	  QNS is a battery charging controller and it necessary to access a
	  kernel driver for a battery charging.
	  This adds sysfs interface which enables QNS daemon to access it.

source "drivers/power/reset/Kconfig"

endif # POWER_SUPPLY

source "drivers/power/avs/Kconfig"
source "drivers/power/qcom/Kconfig"
```
