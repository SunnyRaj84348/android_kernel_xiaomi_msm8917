#include "msm8917-audio-riva.dtsi"
#include "msm8917-camera-pinctrl-riva.dtsi"
#include "msm8917-pinctrl-riva.dtsi"
#include "msm8917-camera-sensor-qrd-riva.dtsi"
#include "msm8917-mdss-riva.dtsi"
#include "msm8917-pm-riva.dtsi"
#include "msm8917-qrd-riva.dtsi"
#include "msm8917-riva.dtsi"
#include "msm8917-sku5-riva.dtsi"
#include "msm8917-spmi-riva.dtsi"
